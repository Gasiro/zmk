## app/boards/arm/vam05_rev/Kconfig.board
```kconfig
# vam05 board configuration

# Copyright (c) 2022 Stefan Sundin (4pplet)
# SPDX-License-Identifier: MIT

config BOARD_VAM05_REV
	bool "vam05 Rev"
	depends on SOC_NRF52840_QIAA
```
